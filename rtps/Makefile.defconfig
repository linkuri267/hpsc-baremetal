## rtps/Makefile.defconfig
```kconfig
# Enable disable tests here:
TEST_FLOAT 					?= 0
TEST_SORT 					?= 0
TEST_GTIMER					?= 0
TEST_WDT					?= 0 # requires CONFIG_RTPS_R52_WDT in trch/Makefile
TEST_RTI_TIMER				?= 0
TEST_RTPS_TRCH_MAILBOX		?= 0
TEST_RTPS_DMA 				?= 0
TEST_RTPS_DMA_CB 			?= 0
TEST_RTPS_MMU 				?= 0
TEST_RT_MMU 				?= 0 # depends on TEST_RT_MMU in TRCH
TEST_SOFT_RESET 			?= 0
TEST_R52_SMP				?= 0

# Set build configuration here
CONFIG_GTIMER 				?= 1
CONFIG_SLEEP_TIMER 			?= 1 # implement sleep() using a timer
CONFIG_WDT 					?= 1
CONFIG_HPPS_RTPS_MAILBOX  	?= 1
CONFIG_CONSOLE				?= NS16550
```

## rtps/rtps.its
```
/dts-v1/;
/ {
    description = "RTPS Bare-Metal App image";
    #address-cells = <1>;
    images {
        app {
                description = "RTPS Bare-Metal App";
                data = /incbin/("./bld/rtps.bin.gz");
                type = "kernel";
                arch = "arm";
                os = "rtems";
                compression = "gzip";
                load  = <0x70000000>;
                entry = <0x70000000>;
                hash {
                    algo = "crc32";
                };
        };
    };

    configurations {
        default = "conf";
        conf {
                description = "Boot Bare-Metal app image";
                kernel = "app";
        };
    };
};
```

## trch-bl0/Makefile.defconfig
```kconfig
# Enable/disable standalone tests here:

# Set build configuration here
CONFIG_CONSOLE					?= NS16550
```
